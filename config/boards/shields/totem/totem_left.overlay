/*
 * Copyright (c) 2022 The ZMK Contributors
 *
 * SPDX-License-Identifier: MIT
 */

#include "totem.dtsi"

/ {
    wakeup_source: wakeup_source {
        compatible = "zmk,gpio-key-wakeup-trigger";
        trigger = <&xiao_d 0 GPIO_ACTIVE_HIGH>;
        wakeup-source;
        extra-gpios = <&xiao_d 4 GPIO_ACTIVE_HIGH>,
                      <&xiao_d 5 GPIO_ACTIVE_HIGH>,
                      <&xiao_d 10 GPIO_ACTIVE_HIGH>,
                      <&xiao_d 9 GPIO_ACTIVE_HIGH>,
                      <&xiao_d 8 GPIO_ACTIVE_HIGH>;
    };
};

&kscan0 {
    col-gpios
        = <&xiao_d 4 GPIO_ACTIVE_HIGH>
        , <&xiao_d 5 GPIO_ACTIVE_HIGH>
        , <&xiao_d 10 GPIO_ACTIVE_HIGH>
        , <&xiao_d 9 GPIO_ACTIVE_HIGH>
        , <&xiao_d 8 GPIO_ACTIVE_HIGH>
        ;
};